# MK10D5 register map
Vendor: Freescale Semiconductor, Inc.; Series: Kinetis_K; File version: 1.6
MK10D5 Freescale Microcontroller
CPU: CM4 r0p1, little endian, no MPU, no FPU, VTOR, 4 interrupt priority bits
Registers are 8-bit, read-write, reset 0x0 unless marked. A register's access mark holds for its fields unless they carry their own. Offsets are from the block's base; lines under a group give offsets from that group; [hi:lo] are bit positions; {n}, {i} and the like mark numbered series; 'fields as' and 'values as' point back to an identical list; <NAME> marks a mode.

## Memory map
0x00000400 FTFL_FlashConfig size 0x10 — Flash configuration field
0x40008000 DMA size 0x1080 — Enhanced direct memory access controller
0x4001F000 FMC size 0x2D0 — Flash Memory Controller
0x40020000 FTFL size 0x18 — Flash Memory Interface
0x40021000 DMAMUX size 0x4 — DMA channel multiplexor
0x4002C000 SPI0 size 0x8C — Deserial Serial Peripheral Interface
0x4002F000 I2S0 size 0x108 — Inter-IC Sound / Synchronous Audio Interface
0x40032000 CRC size 0xC — Cyclic Redundancy Check
0x40036000 PDB0 size 0x19C — Programmable Delay Block
0x40037000 PIT size 0x140 — Periodic Interrupt Timer
0x40038000 FTM0 size 0x9C — FlexTimer Module
0x40039000 FTM1 size 0x9C — FlexTimer Module
0x4003B000 ADC0 size 0x70 — Analog-to-Digital Converter
0x4003D000 RTC size 0x808 — Secure Real Time Clock
0x4003E000 RFVBAT size 0x20 — VBAT register file
0x40040000 LPTMR0 size 0x10 — Low Power Timer
0x40041000 RFSYS size 0x20 — System register file
0x40045000 TSI0 size 0x124 — Touch Sensing Input
0x40047000 SIM size 0x1064 — System Integration Module
0x40049000 PORTA size 0xA4 — Pin Control and Interrupts
0x4004A000 PORTB size 0xA4 — Pin Control and Interrupts
0x4004B000 PORTC size 0xA4 — Pin Control and Interrupts
0x4004C000 PORTD size 0xCC — Pin Control and Interrupts
0x4004D000 PORTE size 0xA4 — Pin Control and Interrupts
0x40052000 WDOG size 0x18 — Generation 2008 Watchdog Timer
0x40061000 EWM size 0x4 — External Watchdog Monitor
0x40062000 CMT size 0xC — Carrier Modulator Transmitter
0x40064000 MCG size 0xE — Multipurpose Clock Generator module
0x40065000 OSC0 size 0x1 — Oscillator
0x40066000 I2C0 size 0xC — Inter-Integrated Circuit
0x4006A000 UART0 size 0x32 — Serial Communication Interface
0x4006B000 UART1 size 0x17 — Serial Communication Interface
0x4006C000 UART2 size 0x17 — Serial Communication Interface
0x40073000 CMP0 size 0x6 — High-Speed Comparator (CMP), Voltage Reference (VREF) Digital-to-Analog Converter (DAC), and Analog Mux (ANMUX)
0x40073008 CMP1 size 0x6 — High-Speed Comparator (CMP), Voltage Reference (VREF) Digital-to-Analog Converter (DAC), and Analog Mux (ANMUX)
0x40074000 VREF size 0x2 — Voltage Reference
0x4007C000 LLWU size 0xB — Low leakage wakeup unit
0x4007D000 PMC size 0x3 — Power Management Controller
0x4007E000 SMC size 0x4 — System Mode Controller
0x4007F000 RCM size 0x8 — Reset Control Module
0x400FF000 PTA size 0x18 — General Purpose Input/Output
0x400FF040 PTB size 0x18 — General Purpose Input/Output
0x400FF080 PTC size 0x18 — General Purpose Input/Output
0x400FF0C0 PTD size 0x18 — General Purpose Input/Output
0x400FF100 PTE size 0x18 — General Purpose Input/Output
0xE000E000 SystemControl blocks up to offset 0xD40 — System Control Registers
0xE000E010 SysTick size 0x10 — System timer
0xE000E100 NVIC size 0xE04 — Nested Vectored Interrupt Controller

## Interrupts
0 DMA0 (DMA)
1 DMA1 (DMA)
2 DMA2 (DMA)
3 DMA3 (DMA)
4 DMA_Error (DMA)
6 FTFL
7 Read_Collision (FTFL)
8 LVD_LVW (PMC)
9 LLW (LLWU)
10 Watchdog (WDOG, EWM)
11 I2C0
12 SPI0
13 I2S0_Tx (I2S0)
14 I2S0_Rx (I2S0)
15 UART0_LON (UART0)
16 UART0_RX_TX (UART0)
17 UART0_ERR (UART0)
18 UART1_RX_TX (UART1)
19 UART1_ERR (UART1)
20 UART2_RX_TX (UART2)
21 UART2_ERR (UART2)
22 ADC0
23 CMP0
24 CMP1
25 FTM0
26 FTM1
27 CMT
28 RTC
29 RTC_Seconds (RTC)
30 PIT0 (PIT)
31 PIT1 (PIT)
32 PIT2 (PIT)
33 PIT3 (PIT)
34 PDB0
37 TSI0
39 LPTimer (LPTMR0)
40 PORTA (PORTA, PTA)
41 PORTB (PORTB, PTB)
42 PORTC (PORTC, PTC)
43 PORTD (PORTD, PTD)
44 PORTE (PORTE, PTE)

## Licence text in the file
Redistribution and use in source and binary forms, with or without modification, are permitted provided that the following conditions are met: o Redistributions of source code must retain the above copyright notice, this list of conditions and the following disclaimer. o Redistributions in binary form must reproduce the above copyright notice, this list of conditions and the following disclaimer in the documentation and/or other materials provided with the distribution. o Neither the name of Freescale Semiconductor, Inc. nor the names of its contributors may be used to endorse or promote products derived from this software without specific prior written permission. THIS SOFTWARE IS PROVIDED BY THE COPYRIGHT HOLDERS AND CONTRIBUTORS "AS IS" AND. ANY EXPRESS OR IMPLIED WARRANTIES, INCLUDING, BUT NOT LIMITED TO, THE IMPLIED. WARRANTIES OF MERCHANTABILITY AND FITNESS FOR A PARTICULAR PURPOSE ARE. DISCLAIMED. IN NO EVENT SHALL THE COPYRIGHT HOLDER OR CONTRIBUTORS BE LIABLE FOR. ANY DIRECT, INDIRECT, INCIDENTAL, SPECIAL, EXEMPLARY, OR CONSEQUENTIAL DAMAGES (INCLUDING, BUT NOT LIMITED TO, PROCUREMENT OF SUBSTITUTE GOODS OR SERVICES; LOSS OF USE, DATA, OR PROFITS; OR BUSINESS INTERRUPTION) HOWEVER CAUSED AND ON. ANY THEORY OF LIABILITY, WHETHER IN CONTRACT, STRICT LIABILITY, OR TORT (INCLUDING NEGLIGENCE OR OTHERWISE) ARISING IN ANY WAY OUT OF THE USE OF THIS. SOFTWARE, EVEN IF ADVISED OF THE POSSIBILITY OF SUCH DAMAGE.
