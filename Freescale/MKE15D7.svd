# MKE15D7 register map
File version: 1.6
MKE15D7 Freescale Microcontroller
Registers are 32-bit, read-write, reset 0x0 unless marked. A register's access mark holds for its fields unless they carry their own. Offsets are from the block's base; lines under a group give offsets from that group; [hi:lo] are bit positions; {n}, {i} and the like mark numbered series; 'fields as' and 'values as' point back to an identical list; <NAME> marks a mode.

## Memory map
0x00000400 FTMRA_FlashConfig size 0x10 — Flash configuration field
0x40000000 AIPS size 0x84 — AIPS-Lite Bridge
0x40008000 DMA size 0x11C0 — Enhanced direct memory access controller
0x4000C000 FB size 0x64 — FlexBus external bus interface
0x4000D000 MPU size 0x820 — Memory protection unit
0x40019000 IEVENT size 0x120 — Intelligent event controller
0x4001F000 FMC size 0x280 — Flash Memory Controller
0x40021000 DMAMUX size 0xE — DMA channel multiplexor
0x40023000 PIT size 0x140 — Periodic Interrupt Timer
0x40024000 CRC size 0xC — Cyclic Redundancy Check
0x40025000 PDB0 size 0x198 — Programmable Delay Block
0x40026000 PDB1 size 0x198 — Programmable Delay Block
0x40027000 PDB2 size 0x198 — Programmable Delay Block
0x40028000 PDB3 size 0x198 — Programmable Delay Block
0x40029000 FTM0 size 0x9C — FlexTimer Module
0x4002A000 FTM1 size 0x9C — FlexTimer Module
0x4002B000 FTM2 size 0x9C — FlexTimer Module
0x4002C000 FTM3 size 0x9C — FlexTimer Module
0x4002D000 RTC size 0xC — Real-time counter
0x40030000 TSI0 size 0x124 — Touch Sensing Input
0x40032000 SIM blocks up to offset 0x64 — System Integration Module
0x40033000 PORTA size 0xCC — Pin Control and Interrupts
0x40034000 PORTB size 0xCC — Pin Control and Interrupts
0x40035000 PORTC size 0xCC — Pin Control and Interrupts
0x40036000 PORTD size 0xCC — Pin Control and Interrupts
0x40037000 PORTE size 0xCC — Pin Control and Interrupts
0x40039000 FTMRA size 0x12 — FTMRA Family Flash Module
0x4003A000 WDOG size 0x18 — Generation 2008 Watchdog Timer
0x4003B000 ADC0 size 0x10 — Analog-to-digital converter
0x4003C000 ADC1 size 0x10 — Analog-to-digital converter
0x4003D000 ADC2 size 0x10 — Analog-to-digital converter
0x4003E000 ADC3 size 0x10 — Analog-to-digital converter
0x40041000 EWM size 0x4 — External Watchdog Monitor
0x40042000 CMT size 0xC — Carrier Modulator Transmitter
0x40044000 ICS size 0x5 — Internal clock source
0x40045000 OSC size 0x1 — Oscillator
0x40047000 I2C0 size 0xC — Inter-Integrated Circuit
0x40048000 I2C1 size 0xC — Inter-Integrated Circuit
0x40049000 UART0 size 0x17 — Serial Communication Interface
0x4004A000 UART1 size 0xF — Serial Communication Interface
0x4004B000 UART2 size 0xF — Serial Communication Interface
0x4004C000 UART3 size 0xF — Serial Communication Interface
0x4004E000 SPI0 size 0xA — Serial Peripheral Interface
0x4004F000 SPI1 size 0xA — Serial Peripheral Interface
0x40050000 CMP0 size 0x7 — High-Speed Comparator (CMP), Voltage Reference (VREF) Digital-to-Analog Converter (DAC), and Analog Mux (ANMUX)
0x40051000 CMP1 size 0x7 — High-Speed Comparator (CMP), Voltage Reference (VREF) Digital-to-Analog Converter (DAC), and Analog Mux (ANMUX)
0x40052000 CMP2 size 0x7 — High-Speed Comparator (CMP), Voltage Reference (VREF) Digital-to-Analog Converter (DAC), and Analog Mux (ANMUX)
0x40053000 CMP3 size 0x7 — High-Speed Comparator (CMP), Voltage Reference (VREF) Digital-to-Analog Converter (DAC), and Analog Mux (ANMUX)
0x40054000 PMC size 0x2 — Power management
0x40056000 SMC size 0x4 — System mode controller
0x40057000 RCM size 0x6 — Reset control module
0x4007F000 PTA size 0x18 — General Purpose Input/Output
0x4007F040 PTB size 0x18 — General Purpose Input/Output
0x4007F080 PTC size 0x18 — General Purpose Input/Output
0x4007F0C0 PTD size 0x18 — General Purpose Input/Output
0x4007F100 PTE size 0x18 — General Purpose Input/Output
0xE000E000 SystemControl blocks up to offset 0xD40 — System Control Registers
0xE000E010 SysTick size 0x10 — System timer
0xE000E100 NVIC size 0xE04 — Nested Vectored Interrupt Controller
0xE0080000 MCM blocks up to offset 0x34 — Core Platform Miscellaneous Control Module

## Interrupts
3 INT_Hard_Fault (SystemControl)
4 INT_Mem_Manage_Fault (SystemControl)
5 INT_Bus_Fault (SystemControl)
6 INT_Usage_Fault (SystemControl)
11 INT_SVCall (SystemControl)
14 INT_PendableSrvReq (SystemControl)
{n+16} INT_DMA{n} (DMA) (n=0..13)
32 INT_DMA_Error (DMA)
34 INT_FTMRA (FTMRA)
36 INT_LVD_LVW (PMC)
38 INT_Watchdog (WDOG)
40 INT_ADC2 (I2C0)
41 INT_SPI0 (SPI0)
42 INT_SPI1 (SPI1)
65 INT_PDB0 (UART2)
69 INT_PIT0 (PIT)
70 INT_PIT1 (PIT)
75 INT_PORTA (PTA)
76 INT_PORTB (PTB)
77 INT_PORTC (PTC)
78 INT_PORTD (PTD)
79 INT_PORTE (PTE)
